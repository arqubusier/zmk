## app/boards/arm/grapto_v3w/Kconfig.board
```kconfig
# Copyright (c) 2023 Herman Lundkvist
# SPDX-License-Identifier: MIT

config BOARD_GRAPTO_V3W_LEFT
	bool "grapto v3w left"
	depends on SOC_NRF52840_QIAA

config BOARD_GRAPTO_V3W_RIGHT
	bool "grapto v3w right"
	depends on SOC_NRF52840_QIAA
```

## app/boards/arm/grapto_v3w/Kconfig.defconfig
```kconfig
# Copyright (c) 2022 Herman Lundkvist
# SPDX-License-Identifier: MIT

if BOARD_GRAPTO_V3W_LEFT

config ZMK_KEYBOARD_NAME
	default "Grapto v3w"

config ZMK_SPLIT_ROLE_CENTRAL
	default y

endif # BOARD_GRAPTO_V3W_LEFT


if BOARD_GRAPTO_V3W_LEFT || BOARD_GRAPTO_V3W_RIGHT 

config BOARD
	default "grapto_v3w"

config ZMK_SPLIT
	default y

config BT_CTLR
	default BT

config ZMK_BLE
	default y

config ZMK_USB
	default y

if USB

config USB_NRFX
	default y

config USB_DEVICE_STACK
	default y

endif # USB

endif # BOARD_GRAPTO_V3W_LEFT || BOARD_GRAPTO_V3W_RIGHT
```
